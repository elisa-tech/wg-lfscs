## buildroot-PoC-framework/package/direct_map_view/Config.in
```kconfig
config BR2_PACKAGE_DIRECT_MAP_VIEW
	bool "DIRECT_MAP_VIEW"
	help
	  Show in ANSI kernel Direct map
```

## buildroot-PoC-framework/package/overcommit_demo/Config.in
```kconfig
config BR2_PACKAGE_OVERCOMMIT_DEMO
	bool "OVERCOMMIT_demo"
	help
	  Small memory overcommit demo.
```

## buildroot-PoC-framework/package/vm_latency_demo/Config.in
```kconfig
config BR2_PACKAGE_VM_LATENCY_DEMO
	bool "vm_latency_demo"
	help
	  Small VM latency demo for anonymous mmap read/write timing.
```
